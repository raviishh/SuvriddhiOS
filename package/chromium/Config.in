## package/chromium/Config.in
```kconfig
config BR2_PACKAGE_RPI_CHROMIUM
    bool "chromium"
    help
      Chromium browser prebuilt from Raspberry Pi OS repos.
```

## package/gcc/Config.in
```kconfig
config BR2_PACKAGE_GCC_FINAL
	bool
	default y if BR2_TOOLCHAIN_BUILDROOT

config BR2_PACKAGE_GCC_TARGET
	bool "gcc"
	depends on BR2_TOOLCHAIN_BUILDROOT
	select BR2_PACKAGE_BINUTILS
	select BR2_PACKAGE_BINUTILS_TARGET
	select BR2_PACKAGE_GMP
	select BR2_PACKAGE_MPFR
	select BR2_PACKAGE_MPC
```
